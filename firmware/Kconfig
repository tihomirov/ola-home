## firmware/Kconfig
```kconfig
# SPDX-License-Identifier: Apache-2.0

menu "Ola Home (hiot)"

config HIOT_CORE
	bool "hiot core: capability registry and command routing"
	select HWINFO
	help
	  Core of the home IoT firmware. Holds the capability registry,
	  produces config/state documents and routes commands to
	  capabilities.

if HIOT_CORE

config HIOT_DEVICE_TYPE
	string "Device type"
	default "generic"
	help
	  Device type string (e.g. "lamp"). Used only for UI grouping and
	  OTA image selection. Behavior comes from capabilities.

config HIOT_FW_VERSION
	string "Firmware version"
	default "0.1.0"

rsource "lib/caps/Kconfig"

module = HIOT
module-str = hiot
source "subsys/logging/Kconfig.template.log_config"

endif # HIOT_CORE

endmenu
```

## firmware/dts/bindings/hiot,brightness.yaml
```yaml
description: |
  hiot brightness capability. Dimmable output driven by one PWM channel
  (gamma-corrected, with fades).

compatible: "hiot,brightness"

properties:
  pwms:
    type: phandle-array
    required: true
    description: PWM channel driving the LED MOSFET.

  fade-ms:
    type: int
    default: 300
    description: Fade duration between levels in milliseconds.
```

## firmware/dts/bindings/hiot,switch.yaml
```yaml
description: |
  hiot switch capability (on/off). Optionally controls another capability
  (e.g. a brightness node: on restores last level, off sets 0).

compatible: "hiot,switch"

properties:
  target:
    type: phandle
    description: Capability node this switch controls.
```

## firmware/dts/bindings/hiot,timer.yaml
```yaml
description: |
  hiot off-timer capability. Turns the target capability off after a delay.

compatible: "hiot,timer"

properties:
  target:
    type: phandle
    required: true
    description: Capability node to turn off (usually a hiot,switch).

  presets-min:
    type: array
    default: [15, 30, 60]
    description: Timer presets in minutes, cycled by local input.
```

## firmware/lib/caps/Kconfig
```kconfig
# SPDX-License-Identifier: Apache-2.0

config HIOT_CAP_SWITCH
	bool "switch capability"
	default y
	depends on DT_HAS_HIOT_SWITCH_ENABLED

config HIOT_CAP_BRIGHTNESS
	bool "brightness capability (PWM)"
	default y
	depends on DT_HAS_HIOT_BRIGHTNESS_ENABLED
	select PWM

config HIOT_CAP_TIMER
	bool "off-timer capability"
	default y
	depends on DT_HAS_HIOT_TIMER_ENABLED
```
